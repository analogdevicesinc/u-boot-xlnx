## arch/arm/mach-zynq/Kconfig
```kconfig
if ARCH_ZYNQ

config SYS_BOARD
	default "zynq"

config SYS_VENDOR
	default "xilinx"

config SYS_SOC
	default "zynq"

config SYS_CONFIG_NAME
	string "Board configuration name"
	default "zynq-common"
	help
	  This option contains information about board configuration name.
	  Based on this option include/configs/<CONFIG_SYS_CONFIG_NAME>.h header
	  will be used for board configuration.

config SYS_MALLOC_F_LEN
	default 0x600

config BOOT_INIT_FILE
	string "boot.bin init register filename"
	default ""
	help
	  Add register writes to boot.bin format (max 256 pairs).
	  Expect a table of register-value pairs, e.g. "0x12345678 0x4321"

config ZYNQ_BOOT_WATCHDOG
	bool "Arm the system watchdog before booting the operating system"
	help
	  Start the system watchdog (SWDT), set to reset the system when it
	  expires, right before U-Boot passes control to the operating
	  system. A kernel that hangs before its own watchdog service takes
	  over then resets the board instead of hanging until power is
	  removed. The watchdog is not running while U-Boot itself runs.

config ZYNQ_BOOT_WATCHDOG_TIMEOUT
	int "System watchdog timeout in seconds"
	depends on ZYNQ_BOOT_WATCHDOG
	range 1 500
	default 60
	help
	  Time the operating system has, from the start of its boot, before
	  the system watchdog resets the board unless serviced.

config ZYNQ_FWSLOT
	bool "A/B firmware slots in QSPI flash"
	depends on DM_SPI_FLASH && FIT
	select ABRECORD
	help
	  Boot one of two firmware slots in QSPI flash, chosen by a boot
	  selector that names the slot in the devcfg MULTIBOOT_ADDR register.
	  Provides the "fwslot" command to load the slot's FIT image and to
	  decide whether a reset lets the selector fall back to the other slot.

endif
```
